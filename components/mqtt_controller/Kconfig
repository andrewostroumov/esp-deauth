## components/mqtt_controller/Kconfig
```kconfig
menu "MQTT Controller"
    config MQTT_URI
        string "MQTT URI"
        default "mqtt://example.com"

    config MQTT_USERNAME
        string "MQTT Username"
        default "espressif"

    config MQTT_PASSWORD
        string "MQTT Password"
        default "password"
endmenu
```

## components/wifi_controller/Kconfig
```kconfig
menu "Wi-Fi Controller"
    config WIFI_SCAN_MAX_AP
        int "Maximun AP scanned"
        default 20
        help
        Maximum number of scanned nearby AP

    config WIFI_AP_SSID
        string "WIFI AP SSID"
        default "Xiaomi"
        help
        SSID of connecting AP

    config WIFI_AP_PASSWORD
        string "WIFI AP Password"
        default "password"
        help
        Password for connecting AP
endmenu
```
